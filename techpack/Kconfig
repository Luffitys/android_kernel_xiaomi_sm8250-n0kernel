## techpack/Kconfig
```kconfig
source techpack/data/drivers/rmnet/perf/Kconfig
source techpack/data/drivers/rmnet/shs/Kconfig

config OSSFOD
	bool "OSS FOD support"
	depends on BOARD_XIAOMI
	help
	  When this option is enabled, OSS FOD support will be added.

menu "Camera packages"

config TECHPACK_CAMERA_XIAOMI
    bool "Xiaomi camera"
    help
      Xiaomi camera

config TECHPACK_CAMERA_XIAOMI_CAS
    bool "Xiaomi camera CAS"
    help
      Xiaomi camera CAS

config TECHPACK_CAMERA_XIAOMI_TABLET
    bool "Xiaomi camera tablet"
    help
      Xiaomi camera tablet

endmenu
```
